#include "Arduino.h"
#include "config.h"

#ifdef TECS_CLUB_LED_SHOW_FEATURE
	#include "TECS_CLUB_MCP23X17.h"
	#include "TASK_SIMPLE.h"
	#include <Arduino_JSON.h>

	typedef struct _LED_SHOW_INFO {
		bool ENABLE;
		bool FLAG_1ST;
		int  PLAY_MAX;
		int  PLAY_CURR;
		uint16_t *PATTERN;
		int  PATTERN_MAX;
		int  PATTERN_INDEX;
	} LED_SHOW_INFO;

	#define MAX_SHOW_COUNT 32

	LED_SHOW_INFO LED_TASKS[MAX_SHOW_COUNT];

	bool ONE_LED_SHOW_COMPLETED = false;

	void INIT_LED_TASKS() {
		for (int i=0; i<MAX_SHOW_COUNT; i++) {
			LED_TASKS[i].ENABLE		= false;
			LED_TASKS[i].FLAG_1ST	= false;
			LED_TASKS[i].PLAY_MAX	= 3;
			LED_TASKS[i].PLAY_CURR	= 0;
		}
	}

	int SHOW_NUMBER = -1;
	void LED_SHOW_SELECTOR() {
		if (!ONE_LED_SHOW_COMPLETED) return;
		ONE_LED_SHOW_COMPLETED = false;
		SHOW_NUMBER = random(7);
	//	SHOW_NUMBER = (SHOW_NUMBER + 1) % 6;
		LED_TASKS[SHOW_NUMBER].ENABLE = true;
	}

	int SPEED_DIV = 1;

	int TIME_LOOP[] = {250,250,30,250,250,60,30};
	int PATTERN_MAX[] = {2, 2, 32, 2, 2, 16, 32};
	uint16_t PATTERN_00[] = { 0b1111111111111111, 0b0000000000000000 };
	uint16_t PATTERN_01[] = { 0b1111111100000000, 0b0000000011111111 };
	uint16_t PATTERN_02[] = {
			0b0000000000000001,
			0b0000000000000010,
			0b0000000000000100,
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			0b0000000000000010,
			0b0000000000000001
		 };
	uint16_t PATTERN_03[] = { 0b1100110011001100, 0b0011001100110011 };
	uint16_t PATTERN_04[] = { 0b1010101010101010, 0b0101010101010101 };
	uint16_t PATTERN_05[] = {
		0b0000000110000000,
		0b0000001001000000,
		0b0000010000100000,
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		0b0000001001000000,
		0b0000000110000000
	};
	uint16_t PATTERN_06[] = {
		0b0000000000000001,
		0b0000000000000011,
		0b0000000000000111,
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		0b1000000000000000,
		0b0000000000000000
	};

	uint16_t *PATTERN_2D[] = {
		PATTERN_00, PATTERN_01, PATTERN_02, PATTERN_03, PATTERN_04, PATTERN_05, PATTERN_06
	};

	void LED_SHOW() {

		TASK_INFO *P = TASK_SIMPLE::GET_TASK_INFO(15);
		P->TIME_LOOP = TIME_LOOP[SHOW_NUMBER] / SPEED_DIV;

		if (!LED_TASKS[SHOW_NUMBER].ENABLE) return;
		if (!LED_TASKS[SHOW_NUMBER].FLAG_1ST) {
			LED_TASKS[SHOW_NUMBER].PATTERN = PATTERN_2D[SHOW_NUMBER];
			LED_TASKS[SHOW_NUMBER].PATTERN_MAX = PATTERN_MAX[SHOW_NUMBER];
			LED_TASKS[SHOW_NUMBER].PATTERN_INDEX = 0;
			LED_TASKS[SHOW_NUMBER].FLAG_1ST = true;
		}

		int INDEX = LED_TASKS[SHOW_NUMBER].PATTERN_INDEX;
		OBJ_TECS_CLUB_MCP23X17.MCP_writeGPIOAB(~LED_TASKS[SHOW_NUMBER].PATTERN[INDEX]);

		LED_TASKS[SHOW_NUMBER].PATTERN_INDEX += 1;

		if (LED_TASKS[SHOW_NUMBER].PATTERN_INDEX >= LED_TASKS[SHOW_NUMBER].PATTERN_MAX) {
			LED_TASKS[SHOW_NUMBER].PATTERN_INDEX = 0;
			LED_TASKS[SHOW_NUMBER].PLAY_CURR += 1;
		}

		if (LED_TASKS[SHOW_NUMBER].PLAY_CURR >= LED_TASKS[SHOW_NUMBER].PLAY_MAX) {
			LED_TASKS[SHOW_NUMBER].ENABLE = false;
			LED_TASKS[SHOW_NUMBER].PLAY_CURR  = 0;
			ONE_LED_SHOW_COMPLETED = true;
		}
	}
/*
	int LED_PIN_NO[] = {15,14,13,12,11,10,9,8,0,1,2,3,4,5,6,7};
	bool FLAG_ON = false;
	int INDEX = 0;
	void LED_SHOW() {
		OBJ_TECS_CLUB_MCP23X17.MCP_pinMode(LED_PIN_NO[INDEX], OUTPUT);

		if (FLAG_ON) {
			OBJ_TECS_CLUB_MCP23X17.MCP_digitalWrite(LED_PIN_NO[INDEX], HIGH);
		} else {
			OBJ_TECS_CLUB_MCP23X17.MCP_digitalWrite(LED_PIN_NO[INDEX], LOW);
		}
		INDEX += 1;
		if (INDEX > 15) {
			INDEX = 0;
			FLAG_ON = !FLAG_ON;
		}
	}
//*/
	bool api_LED_SKIP = false;
	void api_LED_SHOW(JSONVar& args_JSON) {
		JSONVar ARGS = args_JSON["ARGS"];
		JSONVar JSON_RES = args_JSON["RES"];

		if (!api_LED_SKIP) {

			INIT_LED_TASKS();

			TASK_SIMPLE::SETUP();
			TASK_SIMPLE::NEW_TASK(LED_SHOW_SELECTOR, 14, 100,  100);
			TASK_SIMPLE::NEW_TASK(LED_SHOW,  15, 100,  250);

			ONE_LED_SHOW_COMPLETED = true;

			api_LED_SKIP = true;
		}
		if (ARGS.hasOwnProperty("S")) {
			SPEED_DIV = JSON.typeof(ARGS["S"]) == String("string") ? atoi((const char *) ARGS["S"]) : (int) ARGS["S"];
		}
	}
#endif
